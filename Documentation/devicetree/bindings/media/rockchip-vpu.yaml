## Documentation/devicetree/bindings/media/rockchip-vpu.yaml
```yaml
# SPDX-License-Identifier: (GPL-2.0 OR BSD-2-Clause)

%YAML 1.2
---
$id: "http://devicetree.org/schemas/media/rockchip-vpu.yaml#"
$schema: "http://devicetree.org/meta-schemas/core.yaml#"

title: Hantro G1 VPU codecs implemented on Rockchip SoCs

maintainers:
  - Ezequiel Garcia <ezequiel@collabora.com>

description:
  Hantro G1 video encode and decode accelerators present on Rockchip SoCs.

properties:
  compatible:
    enum:
      - rockchip,rk3188-vpu
      - rockchip,rk322x-vpu
      - rockchip,rk3288-vpu
      - rockchip,rk3328-vpu
      - rockchip,rk3399-vpu

  reg:
    maxItems: 1

  interrupts:
    maxItems: 2

  interrupt-names:
    items:
      - const: vepu
      - const: vdpu

  clocks:
    maxItems: 2

  clock-names:
    items:
      - const: aclk
      - const: hclk

  power-domains:
    maxItems: 1

  iommus:
    maxItems: 1

required:
  - compatible
  - reg
  - interrupts
  - interrupt-names
  - clocks
  - clock-names

examples:
  - |
        #include <dt-bindings/clock/rk3288-cru.h>
        #include <dt-bindings/interrupt-controller/arm-gic.h>

        vpu: video-codec@ff9a0000 {
                compatible = "rockchip,rk3288-vpu";
                reg = <0x0 0xff9a0000 0x0 0x800>;
                interrupts = <GIC_SPI 9 IRQ_TYPE_LEVEL_HIGH>,
                             <GIC_SPI 10 IRQ_TYPE_LEVEL_HIGH>;
                interrupt-names = "vepu", "vdpu";
                clocks = <&cru ACLK_VCODEC>, <&cru HCLK_VCODEC>;
                clock-names = "aclk", "hclk";
                power-domains = <&power RK3288_PD_VIDEO>;
                iommus = <&vpu_mmu>;
        };

        vpu: video-codec@ff350000 {
                compatible = "rockchip,rk3328-vpu";
                reg = <0x0 0xff350000 0x0 0x800>;
                interrupts = <GIC_SPI 9 IRQ_TYPE_LEVEL_HIGH>;
                interrupt-names = "vdpu";
                clocks = <&cru ACLK_VPU>, <&cru HCLK_VPU>;
                clock-names = "aclk", "hclk";
                power-domains = <&power RK3328_PD_VPU>;
                iommus = <&vpu_mmu>;
        };
```

## Documentation/devicetree/bindings/mtd/rockchip,nand.yaml
```yaml
# SPDX-License-Identifier: (GPL-2.0-only OR BSD-2-Clause)
%YAML 1.2
---
$id: http://devicetree.org/schemas/mtd/rockchip,nand.yaml#
$schema: http://devicetree.org/meta-schemas/core.yaml#

title: Rockchip SoCs NAND FLASH Controller (NFC) Device Tree Bindings

allOf:
  - $ref: "nand-controller.yaml"

maintainers:
  - Yifeng Zhao <yifeng.zhao@rock-chips.com>

properties:
  "#address-cells": true
  "#size-cells": true

  compatible:
    enum:
      - rockchip,px30_nfc
      - rockchip,rk3308_nfc
      - rockchip,rv1108_nfc
      - rockchip,rk3066_nfc
      - rockchip,rk3188_nfc
      - rockchip,rk3288_nfc
      - rockchip,rk3368_nfc
      - rockchip,rk2928_nfc
      - rockchip,rk3036_nfc
      - rockchip,rk3128_nfc
      - rockchip,rk3228_nfc

  reg:
    maxItems: 1

  interrupts:
    maxItems: 1

  clocks:
    items:
      - description: Module Clock
      - description: Bus Clock

  clock-names:
    items:
      - const: nfc
      - const: ahb

patternProperties:
  "^nand@[0-3]$":
    type: object
    properties:
      reg:
        minimum: 0
        maximum: 3

      nand-ecc-step-size:
        const: 1024

      nand-ecc-strength:
        enum: [16, 24 , 40, 60, 70]

      nand-bus-width:
        const: 8

required:
  - compatible
  - reg
  - interrupts
  - clocks
  - clock-names

examples:
  - |
    #include <dt-bindings/interrupt-controller/arm-gic.h>
    #include <dt-bindings/clock/rk3308-cru.h>
    nfc: nand-controller@ff4b0000 {
      compatible = "rockchip,nfc";
      reg = <0x0 0xff4b0000 0x0 0x4000>;
      interrupts = <GIC_SPI 81 IRQ_TYPE_LEVEL_HIGH>;
      clocks = <&cru SCLK_NANDC>, <&cru HCLK_NANDC>;
      clock-names = "nfc", "ahb";
      assigned-clocks = <&clks SCLK_NANDC>;
      assigned-clock-rates = <150000000>;

      pinctrl-names = "default";
      pinctrl-0 = <&flash_csn0 &flash_rdy &flash_ale &flash_cle
                  &flash_wrn &flash_rdn &flash_bus8>;

      #address-cells = <1>;
      #size-cells = <0>;
      nand@0 {
        reg = <0>;
        nand-ecc-mode = "hw";
        nand-ecc-strength = <16>;
        nand-ecc-step-size = <1024>;
        nand-bus-width = <8>;
      };
    };

...
```

## drivers/net/wireless/rockchip_wlan/rtl8723ds/Kconfig
```kconfig
# SPDX-License-Identifier: GPL-2.0
config RTL8723DS_RK
	tristate "Realtek 8723D SDIO or SPI WiFi RK"
	help
	  Help message of RTL8723DS
```

## drivers/net/wireless/rockchip_wlan/rtl8723du/Kconfig
```kconfig
config RTL8723DU_RK
	tristate "Realtek 8723D USB WiFi RK"
	help
	  Help message of RTL8723DU
```
