/dts-v1/;
/plugin/;


#include <dt-bindings/gpio/gpio.h>
#include <dt-bindings/pinctrl/rockchip.h>
#include <dt-bindings/power/rk3568-power.h>

/ {	
	compatible = "rockchip,rk3568";
	
	fragment@0 {
		target = <&rkisp>;
		
		__overlay__ {
			status = "okay";
		};
	};
	
	fragment@1 {
		target = <&rkcif>;
		
		__overlay__ {
			status = "okay";		
		};
	};
	
	fragment@2 {
		target = <&ov5647>;
		
		__overlay__ {
			
			status = "okay";
			};
	};
			
};
