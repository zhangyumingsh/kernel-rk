/dts-v1/;
/plugin/;

#include <dt-bindings/gpio/gpio.h>
#include <dt-bindings/pinctrl/rockchip.h>
#include <dt-bindings/power/rk3568-power.h>
#include <dt-bindings/interrupt-controller/irq.h>

/ {		
	fragment@0 {
		target = <&uart7>;

		__overlay__ {
			pinctrl-names = "default";
			pinctrl-0 = <&uart7m2_xfer>;
			status = "okay";
		
		};
	};
	
};	
