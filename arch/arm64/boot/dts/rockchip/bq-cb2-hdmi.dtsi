// SPDX-License-Identifier: (GPL-2.0+ OR MIT)
/*
 * Copyright (c) 2020 Rockchip Electronics Co., Ltd.
 *
 */


&hdmi {
	status = "disabled";
};

&hdmi_in_vp0 {
	status = "disabled";
};

&route_hdmi {
	status = "okay";
	connect = <&vp0_out_hdmi>;
};
